## components/ui/Kconfig
```kconfig
menu "LVGL UI Configuration"

    config LVGL_TASK_PRIORITY
        int "LVGL Task Priority"
        default 5
        range 1 24
        help
            Priority of the LVGL task (1-24).
            Higher values = higher priority.

    config LVGL_TICK_PERIOD_MS
        int "LVGL Tick Period (ms)"
        default 5
        range 1 100
        help
            Timer tick period for LVGL internal tick counter.
            Lower values = more responsive but higher CPU usage.

endmenu
```

## main/Kconfig.projbuild
```kconfig
menu "UDC-2 Display Configuration"

    config LCD_BL_BRIGHTNESS_LEDC_CH
        int "LEDC channel for backlight"
        default 1
        range 0 7
        help
            LEDC channel used to generate PWM signal for display backlight.

endmenu
```
